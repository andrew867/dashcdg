## platform/espidf/projects/dashcdg_badge/main/Kconfig.projbuild
```kconfig
menu "DashCDG badge"

    config DASHCDG_BADGE_EXEC_TRACE
        bool "Executive: structured UART trace lines"
        default y
        help
            When enabled, badge_exec emits short structured `[exec-trace]` lines on every boot
            event, health transition, task registration, and orchestrator decision. Lines are
            single-line, ASCII only, and rate-limited by event cadence (not by a tick), so the
            UART load is small. Disable to silence the lines without removing the executive.
            See docs/ops/esp32-badge-freertos-telemetry-runbook.md for the parser contract.

    config DASHCDG_BADGE_EXEC_LOCK_TIMEOUT_MS
        int "Executive: health/task table mutex wait timeout (ms)"
        range 5 200
        default 20
        help
            Maximum time a publisher will wait to update the executive health/task table. The
            mutex is only held for trivial copies, so timeouts here indicate a real RTOS problem.
            On timeout the publisher returns ESP_ERR_TIMEOUT and the caller logs/drops; heartbeats
            use a non-blocking attempt and silently skip on contention.

    config DASHCDG_BADGE_EXEC_WIFI_DHCP_TIMEOUT_MS
        int "Executive: boot DHCP timeout (ms) before publishing BOOT_WIFI_DHCP_TIMEOUT"
        range 1000 60000
        default 10000
        help
            Latched boot fact. If the saved-credentials connect succeeds (WIFI_EVENT_STA_CONNECTED)
            but no IP_EVENT_STA_GOT_IP arrives within this window, badge_exec publishes
            BOOT_WIFI_DHCP_TIMEOUT and marks SUB_WIFI_STA as TIMEOUT. The background reconnect task
            continues running; this bit only feeds the orchestrator's nominal/degraded decision.

    config DASHCDG_BADGE_EXEC_LIVENESS_SWEEP_MS
        int "Executive: liveness sweep interval (ms)"
        range 100 60000
        default 1000
        help
            How often badge_exec walks the task registry to refresh stack high-water marks and
            check per-task heartbeat lag. The sweep runs from an esp_timer dispatch task and
            performs only registry walks (no I/O). 1 s is the recommended default for soak builds;
            lower (250-500 ms) helps catch transient stalls in development.

    config DASHCDG_BADGE_EXEC_LIVENESS_STALL_MS
        int "Executive: per-task stall threshold (ms)"
        range 200 30000
        default 6000
        help
            A registered task is "stalled" when (now - last_heartbeat_ms) exceeds this threshold.
            The sweep emits an [exec-trace] line for every stall observation and increments the
            global stalls_observed counter. T7 enforce-mode (below) decides whether a stall also
            transitions the owning subsystem health to DEGRADED.

            Default is sized for the longest legitimate idle waiter on the badge (wifi_reconn
            backoff up to 5 s); tasks that intend to sleep longer must chunk their wait with
            explicit heartbeats. Drop to 1000-2000 ms when actively investigating slow paths.

    config DASHCDG_BADGE_EXEC_LIVENESS_ENFORCE
        bool "Executive: liveness sweep enforces health transitions"
        default n
        help
            Per the executive refactor spec (T7) liveness starts in observe-only mode -- the sweep
            logs stalls but does not change any subsystem health. After a clean soak run, enable
            this to let the sweep mark the owning subsystem DEGRADED when a stall is observed.
            Recovery is policy-defined and lives in the orchestrator; the sweep itself never
            touches the WDT or restarts tasks.

    config DASHCDG_BADGE_UI_TICK_OVERRUN_US
        int "Executive: LVGL tick overrun budget (microseconds)"
        range 1000 200000
        default 30000
        help
            Per-tick wall-time budget used by dashcdg_badge_exec_ui_tick_observe. Each LVGL timer
            that opts in calls this helper at the end of its callback. When the measured tick
            duration exceeds this budget the executive increments an overrun counter for that
            timer and emits a throttled ESP_LOGW + [exec-trace] line. T8 is observe-only: there
            is no automatic recovery or health transition.
            30 ms is calibrated against the measured karaoke_ui envelope (CDG blit + status bar
            update + RX overlay tick lands at 24-31 ms on a 33 ms period); leaves a hair of
            headroom and reserves the alarm for genuine outliers. Lower (e.g. 20-25 ms) during
            development to surface marginal ticks earlier.

    config DASHCDG_BADGE_UI_TICK_LOG_THROTTLE_MS
        int "Executive: throttle between LVGL tick overrun ESP_LOGW lines (ms)"
        range 100 60000
        default 5000
        help
            Per-name minimum spacing between overrun ESP_LOGW lines. The counters and last_us /
            max_us fields are always updated; only the log line is throttled so a bursty overrun
            window does not flood the UART. The structured [exec-trace] line is emitted on the
            same throttle as the ESP_LOGW.

    config DASHCDG_BADGE_DAC_DEGRADE_DROPS
        int "DAC route: wrong-owner drop count that latches SUB_DAC = DEGRADED"
        range 8 100000
        default 256
        help
            When dashcdg_platform_hw_dac_route_get_stats.wrong_owner_drops crosses this
            threshold the platform publishes BOOT_DAC_DEGRADED and transitions SUB_DAC ->
            DEGRADED ("route_conflict_drops"). The transition is one-shot per boot; the
            counter keeps climbing for forensics but no further health transitions occur.
            Audio still attempts to play on the surviving route. Set higher for environments
            with bursty arbitration; lower for early bring-up to flag misuse aggressively.

    config DASHCDG_BADGE_DAC_DEGRADE_TIMEOUTS
        int "DAC route: I/O mutex timeout count that latches SUB_DAC = DEGRADED"
        range 4 100000
        default 64
        help
            Sum of dashcdg_platform_hw_dac_route_get_stats.io_mtx_timeouts_push +
            io_mtx_timeouts_stop. Crossing this threshold transitions SUB_DAC -> DEGRADED
            ("route_io_mtx_timeouts"). One-shot per boot; the push path itself remains a
            bounded wait + drop chunk (so audio glitches rather than the badge wedging).

    config DASHCDG_BADGE_OPUS_MONO_ONLY
        bool "Opus RX: mono decoder only (saves internal RAM)"
        default y
        help
            Restrict the badge Opus path to a mono decoder: smaller opus_decoder_get_size() blob and
            no stereo PCM scratch in the decoder. Stereo Opus streams will fail decode (use mono from TX).
            Turn off if you must play stereo Opus on the badge.

    config DASHCDG_BADGE_RX_CDG_ON_HEAP
        bool "CDG + jitter on heap (free when RX stops)"
        default n
        help
            Places CDG decode state and the batch jitter buffer in internal heap instead of .bss.
            dashcdg_badge_rx_stop() frees them (plus blit scratch and v4 anchor assembly) so RAM is
            reclaimed when leaving karaoke. Static .bss mode avoids that free and keeps buffers warm
            for quick re-entry; heap mode trades a bit of fragmentation risk for smaller idle firmware RAM.

    config DASHCDG_BADGE_DEBUG_AUTO_LAUNCH_KARAOKE_AFTER_DHCP
        bool "DEBUG: auto-launch Karaoke once after first DHCP"
        default n
        help
            Debug automation helper. When enabled, after the first STA DHCP lease on each boot,
            the app auto-navigates to Karaoke once per boot. Karaoke decode toggles remain whatever
            is saved in NVS / set in karaoke settings UI (never forced).
            Intended for soak/debug loops; keep off for normal interactive use.

    config DASHCDG_BADGE_CDG_JB_HEADROOM_EXTRA
        int "Extra CDG jitter headroom slots (0-12)"
        range 0 12
        default 0
        help
            Added to the CDG batch jitter headroom used for insert/evict pressure. Higher values keep
            more empty slots for bursty Wi-Fi and reorder, at the cost of earlier evictions when the
            ring is tight.

    config DASHCDG_BADGE_ENABLE_REPAIR_NACK
        bool "v4 CDG repair NACK uplink to TX"
        default n
        help
            When enabled, sends v4_repair_nack when FEC groups have missing members (split repair port).
            Disabled by default on ESP32 to save code size and DRAM; many setups do not use badge NACK.

    config DASHCDG_BADGE_REPAIR_NACK_THROTTLE
        bool "Adaptive throttle for v4 repair NACK uplink"
        depends on DASHCDG_BADGE_ENABLE_REPAIR_NACK
        default y
        help
            Enforces a minimum time between repair NACK send attempts. The spacing grows when STA
            RSSI is below a reference (weaker link), to cap uplink airtime and reduce self-induced
            contention. PHY/MCS is not exposed on ESP32 in a portable way; RSSI is used as the link
            quality proxy.

    config DASHCDG_BADGE_REPAIR_NACK_MIN_GAP_MS
        int "NACK min-spacing base (ms)"
        depends on DASHCDG_BADGE_REPAIR_NACK_THROTTLE
        range 20 500
        default 50

    config DASHCDG_BADGE_REPAIR_NACK_MAX_GAP_MS
        int "NACK min-spacing ceiling (ms)"
        depends on DASHCDG_BADGE_REPAIR_NACK_THROTTLE
        range 50 800
        default 400

    config DASHCDG_BADGE_REPAIR_NACK_RSSI_REF_DB
        int "RSSI reference (dBm); below this adds extra spacing"
        depends on DASHCDG_BADGE_REPAIR_NACK_THROTTLE
        range -90 -40
        default -65

    config DASHCDG_BADGE_REPAIR_NACK_RSSI_EXTRA_MS_PER_DB
        int "Extra ms per dB below RSSI reference"
        depends on DASHCDG_BADGE_REPAIR_NACK_THROTTLE
        range 0 20
        default 2

    config DASHCDG_BADGE_REPAIR_NACK_RSSI_EXTRA_CAP_MS
        int "Max extra ms from RSSI term"
        depends on DASHCDG_BADGE_REPAIR_NACK_THROTTLE
        range 0 400
        default 200

    config DASHCDG_BADGE_PERF_PROBES
        bool "Perf probes: mutex/blit timing counters (UART optional)"
        default n
        help
            When enabled, records high-water mutex dwell and SPI blit time for T0 baselines.
            Counters are exposed via dashcdg_badge_rx_get_stats / optional periodic ESP_LOGI.

    config DASHCDG_BADGE_CDG_DEFERRED_BLIT
        bool "CDG overlay: deferred SPI blit worker (experimental; validate on HW)"
        default n
        help
            LVGL enqueues RGB565 band jobs; a dedicated FreeRTOS task performs esp_lcd_panel_draw_bitmap
            + inter-band settle delay so badge_rx s_mtx is not held across SPI/DMA.

    config DASHCDG_BADGE_SP_BLIT_POOL_SLOTS
        int "Deferred CDG blit: RGB565 band pool slots (2-16)"
        depends on DASHCDG_BADGE_CDG_DEFERRED_BLIT
        range 2 16
        default 8
        help
            Each slot holds one band (288x12 RGB565). More slots reduce drops under SPI back-pressure;
            each slot costs ~6.9 KiB internal DRAM.

    config DASHCDG_BADGE_SP_BLIT_TASK_PRIO
        int "Deferred CDG blit worker task priority (FreeRTOS)"
        depends on DASHCDG_BADGE_CDG_DEFERRED_BLIT
        range 1 15
        default 4
        help
            Keep below or near the badge RX task (5) so real-time UDP decode is not starved.

    config DASHCDG_BADGE_RX_PUMP_MUTEX_MS
        int "RX media pump: s_mtx wait timeout ms"
        range 20 5000
        default 400
        help
            Bounds xSemaphoreTake in badge_rx_pump_main_fd. On timeout the datagram is dropped
            (counter rx_mtx_pump_timeouts). The minimum (20 ms) is enforced because the FreeRTOS
            executive refactor (T5) forbids unbounded waits in hot paths -- portMAX_DELAY here
            would mask priority-inversion stalls from the watchdog.

    config DASHCDG_BADGE_RX_REPAIR_MUTEX_MS
        int "RX repair recv: s_mtx wait timeout ms"
        range 20 5000
        default 400
        help
            Same semantics as the pump timeout for repair/FEC recv loops (counter
            rx_mtx_repair_timeouts). Minimum 20 ms by T5 design contract.

    config DASHCDG_BADGE_DAC_WRITE_TIMEOUT_MS
        int "Karaoke DAC: dac_continuous_write max block ms (0 = infinite)"
        range 0 200
        default 0
        help
            Pass-through to ESP-IDF `dac_continuous_write(..., timeout_ms)` (negative only via 0 here).
            Short finite values (e.g. 12 ms) cause `Get available descriptor timeout` under Wi-Fi/LVGL load.
            Use 0 for infinite wait unless debugging stuck DAC.

    config DASHCDG_BADGE_RX_SELECT_TIMEOUT_MS
        int "RX select timeout when video decode is on (ms)"
        range 4 80
        default 12
        help
            `select` wake period for CDG+LVGL coex vs Wi-Fi modem sleep / IGMP refresh. Lower = more
            CPU wakeups; higher = riskier audio underrun. Tuned with `platform_hw` karaoke PS_NONE.

    config DASHCDG_BADGE_RX_SELECT_TIMEOUT_AUDIO_ONLY_MS
        int "RX select timeout when audio-only decode (ms)"
        range 2 50
        default 6
        help
            Shorter wake when CDG drain is off — keeps DAC + Opus drain cadence tighter.

    config DASHCDG_BADGE_AUDIO_DIAG_UART_INFO
        bool "UART: audio chop / proof lines at INFO (default DEBUG)"
        default n
        help
            When enabled, badge_rx prints `audio_chop`, `AUDIO_UART_PROOF`, and audio_only cumulative
            lines at ESP_LOGI once per second while decode is on — useful for field RCA without raising
            global log level. Keep off for normal builds (UART bandwidth + CPU).

endmenu
```
